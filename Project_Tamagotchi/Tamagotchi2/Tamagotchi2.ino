
/*
MKR1000 connecting to MQTT broker test.mosquitto.org

MQTT protocol will be used for communication
  MKR1000 --  MQTT broker --- ComApp --- ProtoPie
 */

#include <IRLibRecvPCI.h> 

#include <SPI.h>
#include <WiFiSSLClient.h>
#include <WiFi101.h>

#include <MQTTClient.h>
#include <SPI.h>
#include <SD.h>
#include <Adafruit_GFX.h>
#include <Adafruit_SSD1331.h> 

#define oledHEIGHT 64 // x
#define oledWIDTH 96 // y
#define SCK 9
#define MOSI 8
#define oledCS 6
#define oledRES 0
#define oledDC 3
#define oledVCCEN 1
#define oledPMODEN 2

uint16_t imgWidth = 25;
uint16_t imgHeight = 24;

//define colors
#define black   0x0000
#define blue    0x001F
#define red     0xF800
#define green   0x07E0
#define cyan    0x07FF
#define magenta 0xF81F
#define yellow  0xFFE0
#define white   0xFFFF

Adafruit_SSD1331 display = Adafruit_SSD1331(oledCS, oledDC, MOSI, SCK, oledRES);  //create the object

const uint16_t fox_map[] ={0xff,0xff,0xff,0xff,0xff,0xff,0xff,0x00,0x00,0xff,0x00,0x00,0xff,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0xff,0xff};

IRrecvPCI myReceiver(4);

// WLAN 
const char ssid[] = "HAMKvisitor"; //  your network SSID (name)
const char pass[] = "hamkvisitor";    // your network password (use for WPA)

//char *client_id = "<write here a unique client ID>";
char *client_id = "Id_Tama_01";    // needs to be unique !!
char *user_id = "";   // empty if no username and password will be used.
char *authToken = ""; // empty if no username and password will be used.

//char *hostname = "<your mqtt broker server name or IP address>";
char *hostname = "test.mosquitto.org";
int pubInterval = 1000;

const int button = A6;           //
const int fadeLED = 5;          // must be a pin that supports PWM. 0...8 on MKR1000

// PWM steps per fade step.  More fades faster; less fades slower.
const int pwmStepsPerFade = 14;

int fadePWM;

//use this class if you connect using SSL WiFiSSLClient net;
WiFiClient net;
MQTTClient MQTTc;

unsigned long lastMillis = 0; 
int fun = 0;
bool displayState = false;

void setup() 
{
  Serial.begin(9600);
  delay(5000);    // waiting to let you open the serial monitor
  WiFi.begin(ssid, pass);
  Serial.println("Connected to WLAN");
  myReceiver.enableIRIn();
  Serial.println(F("Ready to receive IR signals"));
  printWiFiStatus();
  
 //Connecting to the MQTT broker client.begin("<hostname>", 1883, net);
  MQTTc.begin(hostname, 1883, net);
  MQTTc.onMessage(messageReceived);
  connect();
  
// Set up the I/O pins
  pinMode(fadeLED, OUTPUT);
  pinMode(button, INPUT);
  fadePWM = 255;
  analogWrite(fadeLED, fadePWM);   // sets PWM duty cycle

  display.begin();  //initialize the display
  display.enableDisplay(true);
  display.fillScreen(black);  //set background and clear everything

  display.drawRGBBitmap((oledWIDTH-imgWidth)>>1, (oledHEIGHT-imgHeight)>>1, fox_map, imgWidth, imgHeight);

  display.setCursor(oledWIDTH/3, oledHEIGHT/5*4); //set cursor position (x, y)
  display.setTextSize(1); //set the size of text
  display.print("Kino"); // display text
  //display.enableDisplay(displayState);
}

void loop() {
   MQTTc.loop();  // Cut for testing without mqtt broker
         
    if(digitalRead(button) == LOW){
      displayState = !displayState;
      Serial.println(displayState);
      display.enableDisplay(displayState);
      while(digitalRead(button) == LOW){
        delay(100);
      }
    }
  
  analogWrite(fadeLED, fadePWM);
  
     // publish a message every nnn milli seconds
     if(millis() - lastMillis > pubInterval) 
     {
      Serial.println("Publishing to MQTT broker...");
        if(!MQTTc.connected()) {    // Cut for testing without MQTT
         connect();                 // Cut for testing without MQTT
        }                           // Cut for testing without MQTT
        lastMillis = millis();
         //Cut for testing without MQTT
         //MQTTc.publish("try-me", "[BALL]:" + String(analogRead(ainputPin)));
   
         MQTTc.publish("signal-in", "[FUN]:" + String(fun));  
        //fadePWM = 255;
     }
    delay(200);

if (myReceiver.getResults()) { 
    Serial.println("Received");
    if(fun < 316){
    fun += 2;
    myReceiver.enableIRIn();
    delay(200);//Restart receiver
    }
  }
  if(fun > 255){
    analogWrite(fadeLED, 255);
  }
  else{
    analogWrite(fadeLED, fun);
  }
  
// end of loop
}

void connect() 
{
  Serial.print("checking WLAN...");
  while (WiFi.status() != WL_CONNECTED) 
  {
    Serial.println("Connecting WLAN...  ");
    Serial.print(".");
    delay(500);
  }
 
  Serial.print("\nconnecting MQTT broker....");
  while (!MQTTc.connect(client_id,user_id,authToken)) 
  {
    Serial.print(".");
    delay(3000);
  }
  Serial.println("\nconnected!");

  MQTTc.subscribe("signal-in");
}

void messageReceived(String &topic, String &payload) {
  Serial.print("incoming: ");
  Serial.print(topic);
  Serial.print(" - ");
  Serial.print(payload);
  Serial.println();

  // String content is received from a ProtoPie connectd app. 
  // There is a certain structure included in the MQTT payload.
  String message = payload.substring(0, payload.indexOf(":"));
  String value = payload.substring(payload.indexOf(":")+1,payload.length());
  if(message == "[FUN]"){
    fadePWM = value.toInt();
   
  }
  if(message == "[LEDON]"){
    fadePWM = 255;
  }
  if(message == "[LEDOFF]"){
    fadePWM = 0;
  }
}

void printWiFiStatus() {
  // print the SSID of the network you're attached to:
  Serial.print("SSID: ");
  Serial.println(WiFi.SSID());

  // print your WiFi shield's IP address:
  IPAddress ip = WiFi.localIP();
  Serial.print("IP Address: ");
  Serial.println(ip);

  // print the received signal strength:
  long rssi = WiFi.RSSI();
  Serial.print("signal strength (RSSI):");
  Serial.print(rssi);
  Serial.println(" dBm");
}
